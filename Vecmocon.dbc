VERSION ""

BA_DEF_ SG_ "CSV_ORDER" INT 0 10000;
BA_DEF_DEF_ "CSV_ORDER" 0;

NS_ :

BS_:

BU_:
BA_ "CSV_ORDER" SG_ 284 BalancingMaskGroup1 27;
BA_ "CSV_ORDER" SG_ 284 BalancingMaskGroup2 28;
